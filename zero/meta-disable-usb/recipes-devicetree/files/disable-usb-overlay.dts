/*
 * Device tree overlay for disable-usb
 */

/dts-v1/;
/plugin/;

/ {
    compatible = "brcm,bcm2835";

    fragment@0 {
        target = <&usb>;
        __overlay__ {
            status = "disabled";
        };
    };
};
