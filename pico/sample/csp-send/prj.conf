## CMakeLists.txt
```
# SPDX-License-Identifier: Apache-2.0

cmake_minimum_required(VERSION 3.20.0)

set(BOARD rpi_pico)

# build options
set(OPTION_PATH "${CMAKE_CURRENT_SOURCE_DIR}/../../options")

## -DCONSOLE=uart1 or usb
if (CONSOLE STREQUAL uart1)
    list(APPEND EXTRA_DTC_OVERLAY_FILE "${OPTION_PATH}/uart1.overlay")
elseif (CONSOLE STREQUAL usb)
    list(APPEND EXTRA_DTC_OVERLAY_FILE "${OPTION_PATH}/usb.overlay")
    list(APPEND EXTRA_CONF_FILE "${OPTION_PATH}/usb.conf")
endif()

## -DALLOW_DEBUG=y
if (ALLOW_DEBUG)
	list(APPEND EXTRA_CONF_FILE "${OPTION_PATH}/debug.conf")
	
	if (CONSOLE STREQUAL usb)
        list(APPEND EXTRA_CONF_FILE "${OPTION_PATH}/usb-debug.conf")
	endif()
endif()

find_package(Zephyr REQUIRED HINTS $ENV{ZEPHYR_BASE})
project(csp-send)

target_sources(app PRIVATE src/main.c)
```

## Kconfig
```
# SPDX-License-Identifier: Apache-2.0

mainmenu "pico-sample: console-echo"

menu "Zephyr Config"
source "Kconfig.zephyr"
endmenu

menu "Logging Config"
module = MAIN
module-str = "console-echo"
source "subsys/logging/Kconfig.template.log_config" # for logging
endmenu
```

## sample.yaml
```
sample:
  name: send csp-uart sample
tests:
  sample.csp-send:
    build_only: true
    platform_allow:
      - rpi_pico
    tags:
      - uart
      - usb_device
```

## prj.conf
```kconfig
CONFIG_SERIAL=y
CONFIG_UART_INTERRUPT_DRIVEN=y
CONFIG_PICOLIBC=y
CONFIG_PICOLIBC_IO_FLOAT=y
CONFIG_LIBCSP=y
CONFIG_POSIX_API=y
```

## src/main.c
```c
/*
 * Copyright (c) 2023 Space Cubics, LLC.
 *
 * SPDX-License-Identifier: Apache-2.0
 */

#include <stdlib.h>
#include <zephyr/kernel.h>
#include <csp/csp.h>
#include <csp/drivers/usart.h>

#include <zephyr/logging/log.h>
LOG_MODULE_REGISTER(main, CONFIG_MAIN_LOG_LEVEL);

extern csp_conf_t csp_conf;

#define SERVER_PORT 10

#define CSP_DST_ADDR 24
#define CSP_SRC_ADDR 26

int main(void)
{
	csp_conf.version = 1;
	LOG_INF("start csp_send application");

	const char *kiss_device = "uart@40034000";

	csp_init();

	csp_iface_t *default_iface = NULL;
	csp_usart_conf_t conf = {.device = kiss_device,
				 .baudrate = 115200,
				 .databits = 8,
				 .stopbits = 1,
				 .paritysetting = 0};
	int error = csp_usart_open_and_add_kiss_interface(&conf, CSP_IF_KISS_DEFAULT_NAME,
							  CSP_SRC_ADDR, &default_iface);
	if (error != CSP_ERR_NONE) {
		LOG_ERR("failed to add KISS interface [%s], error: %d", kiss_device, error);
		exit(1);
	}
	default_iface->is_default = 1;

	LOG_DBG("successful add KISS interface [%s]", kiss_device);

	while (1) {
		csp_conn_t *conn =
			csp_connect(CSP_PRIO_NORM, CSP_DST_ADDR, SERVER_PORT, 1000, CSP_O_NONE);
		if (conn == NULL) {
			LOG_ERR("Connection failed");
			exit(1);
		}

		csp_packet_t *packet = csp_buffer_get(100);
		if (packet == NULL) {
			LOG_ERR("Failed to get CSP buffer");
			exit(1);
		}

		char message[] = "Hello World";
		memcpy(packet->data, message, 12);
		packet->length = (strlen((char *)packet->data) + 1); /* include the 0 termination */

		csp_send(conn, packet);
		csp_close(conn);

		LOG_DBG("message (%s) send to [%s]", packet->data, kiss_device);

		k_sleep(K_MSEC(1000));
	}

	return 0;
}
```
