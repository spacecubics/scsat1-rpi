## pico/sample/console-echo/sample.yaml
```yaml
sample:
  name: console echo server sample
tests:
  sample.console-echo:
    build_only: true
    platform_allow:
      - rpi_pico
    tags:
      - uart
      - usb_device
```

## pico/sample/console-hello/Kconfig
```kconfig
# SPDX-License-Identifier: Apache-2.0

mainmenu "pico-sample: console-hello"

menu "Zephyr Config"
source "Kconfig.zephyr"
endmenu

menu "Logging Config"
module = MAIN
module-str = "console-hello"
source "subsys/logging/Kconfig.template.log_config" # for logging
endmenu
```

## pico/sample/console-hello/sample.yaml
```yaml
sample:
  name: console output sample
tests:
  sample.console-hello:
    build_only: true
    platform_allow:
      - rpi_pico
    tags:
      - uart
      - usb_device
```

## pico/sample/csp-server/sample.yaml
```yaml
sample:
  name: csp uart server sample
tests:
  sample.csp-server:
    build_only: true
    platform_allow:
      - rpi_pico
    tags:
      - uart
      - usb_device
```

## west.yml
```yaml
manifest:

  projects:
    - name: zephyr
      url: https://github.com/zephyrproject-rtos/zephyr
      revision: 30af4b26968c640d605f6e7853cff4e8daebe4f8
      path: zephyr
      west-commands: scripts/west-commands.yml
      import:
        name-allowlist:
          - cmsis
          - hal_rpi_pico

    - name: libcsp
      url: https://github.com/libcsp/libcsp.git
      revision: 1653d5b340cdf97ceb97dbf84b2dcbbfe8623e8c
      path: modules/lib/libcsp

    - name: mcuboot
      url: https://github.com/zephyrproject-rtos/mcuboot
      revision: f74b77cf7808919837c0ed14c2ead3918c546349
      path: bootloader/mcuboot

    - name: zcbor
      url: https://github.com/zephyrproject-rtos/zcbor
      revision: 75d088037eb237b18e7ec1f47c9ce494b9b95aab
      path: modules/lib/zcbor
```

## zero/meta-arducam/conf/layer.conf
```bitbake
# We have a conf and classes directory, add to BBPATH
BBPATH .= ":${LAYERDIR}"

# We have recipes-* directories, add to BBFILES
BBFILES += "\
    ${LAYERDIR}/recipes-kernel/linux/linux-raspberrypi_%.bbappend \
    ${LAYERDIR}/recipes-multimedia/arducam-pivariety/arducam-pivariety_*.bb \
"

BBFILE_COLLECTIONS += "arducam"
BBFILE_PATTERN_arducam = "^${LAYERDIR}/"
BBFILE_PRIORITY_arducam = "6"

LAYERDEPENDS_arducam = "raspberrypi"
LAYERSERIES_COMPAT_arducam = "kirkstone"

KERNEL_DEVICETREE:append = " overlays/arducam-pivariety.dtbo"
RPI_EXTRA_CONFIG:append = "dtoverlay=arducam-pivariety\n"
IMAGE_INSTALL:append = "\
    kernel-module-arducam-pivariety \
    kernel-module-bcm2835-isp \
    kernel-module-bcm2835-unicam \
    kernel-module-v4l2-fwnode \
    kernel-module-v4l2-async \
    kernel-module-videodev \
    kernel-module-mc \
"
```

## zero/meta-csp/conf/layer.conf
```bitbake
# We have a conf and classes directory, add to BBPATH
BBPATH .= ":${LAYERDIR}"

# We have recipes-* directories, add to BBFILES
BBFILES += "${LAYERDIR}/recipes-cspd/csp-handler/csp-handler_*.bb \
            ${LAYERDIR}/recipes-cspd/systemd/cspd_*.bb \
            ${LAYERDIR}/recipes-csp-server-client/csp-server-client_*.bb\
            ${LAYERDIR}/recipes-core/systemd/systemd-serialgetty.bbappend"

BBFILE_COLLECTIONS += "csp"
BBFILE_PATTERN_csp = "^${LAYERDIR}/"
BBFILE_PRIORITY_csp = "6"

LAYERDEPENDS_csp = "libcsp"
LAYERSERIES_COMPAT_csp = "kirkstone"

IMAGE_INSTALL:append = " csp-handler cspd csp-server-client"

ENABLE_UART = "1"
ENABLE_I2C = "1"
```

## zero/meta-debug/conf/layer.conf
```bitbake
# We have a conf and classes directory, add to BBPATH
BBPATH .= ":${LAYERDIR}"

# We have recipes-* directories, add to BBFILES
BBFILES += "${LAYERDIR}/recipes-connectivity/wpa-supplicant/wpa-supplicant_%.bbappend \
            "

BBFILE_COLLECTIONS += "meta-debug"
BBFILE_PATTERN_meta-debug = "^${LAYERDIR}/"
BBFILE_PRIORITY_meta-debug = "6"

LAYERDEPENDS_meta-debug = "core"
LAYERSERIES_COMPAT_meta-debug = "kirkstone"

EXTRA_IMAGE_FEATURES:append = " debug-tweaks"
IMAGE_INSTALL:append = " can-utils \
    linux-firmware-rpidistro-bcm43430 kernel-module-cfg80211 kernel-module-brcmfmac \
    wpa-supplicant \
"
```

## zero/meta-disable-hdmi/conf/layer.conf
```bitbake
#For the HDMI to be disable we don't have to have a proper layer, 
# so we modify only the RPI extra config

RPI_EXTRA_CONFIG:append = "\
hdmi_blanking=2\n\
hdmi_ignore_hotplug=1\n\
"
```

## zero/meta-disable-usb/conf/layer.conf
```bitbake
# We have a conf and classes directory, add to BBPATH
BBPATH .= ":${LAYERDIR}"

# We have recipes-* directories, add to BBFILES
BBFILES += "${LAYERDIR}/recipes-devicetree/linux-raspberrypi_%.bbappend"

BBFILE_COLLECTIONS += "disable_usb"
BBFILE_PATTERN_disable_usb = "^${LAYERDIR}/"
BBFILE_PRIORITY_disable_usb = "6"

LAYERDEPENDS_disable_usb = "raspberrypi"
LAYERSERIES_COMPAT_disable_usb = "kirkstone"

KERNEL_DEVICETREE:append = " overlays/disable-usb.dtbo"
RPI_EXTRA_CONFIG:append = "dtoverlay=disable-usb\n"
```

## zero/meta-disable-wifi/conf/layer.conf
```bitbake
# We have a conf and classes directory, add to BBPATH
BBPATH .= ":${LAYERDIR}"

# We have recipes-* directories, add to BBFILES
BBFILES += "${LAYERDIR}/recipes-devicetree/linux-raspberrypi_%.bbappend"

BBFILE_COLLECTIONS += "disable-wifi"
BBFILE_PATTERN_disable-wifi = "^${LAYERDIR}/"
BBFILE_PRIORITY_disable-wifi = "6"

LAYERDEPENDS_disable-wifi = "raspberrypi"
LAYERSERIES_COMPAT_disable-wifi = "kirkstone"

KERNEL_DEVICETREE:append = " overlays/disable-wifi.dtbo"
RPI_EXTRA_CONFIG:append = "dtoverlay=disable-wifi\n"
```

## zero/meta-libcsp/conf/layer.conf
```bitbake
# We have a conf and classes directory, add to BBPATH
BBPATH .= ":${LAYERDIR}"

# We have recipes-* directories, add to BBFILES
BBFILES += "${LAYERDIR}/recipes-libcsp/libcsp_*.bb"

BBFILE_COLLECTIONS += "libcsp"
BBFILE_PATTERN_libcsp = "^${LAYERDIR}/"
BBFILE_PRIORITY_libcsp = "6"

LAYERDEPENDS_libcsp = "core"
LAYERSERIES_COMPAT_libcsp = "kirkstone"
```

## zero/meta-mcp2517fd/conf/layer.conf
```bitbake
# We have a conf and classes directory, add to BBPATH
BBPATH .= ":${LAYERDIR}"

# We have recipes-* directories, add to BBFILES
BBFILES += "${LAYERDIR}/recipes-devicetree/linux-raspberrypi_%.bbappend"

BBFILE_COLLECTIONS += "mcp2517fd"
BBFILE_PATTERN_mcp2517fd = "^${LAYERDIR}/"
BBFILE_PRIORITY_mcp2517fd = "6"

LAYERDEPENDS_mcp2517fd = "raspberrypi"
LAYERSERIES_COMPAT_mcp2517fd = "kirkstone"

KERNEL_DEVICETREE:append = " overlays/mcp2517fd.dtbo"
RPI_EXTRA_CONFIG:append = "\
dtparam=spi=on \n \
dtoverlay=mcp2517fd \n \
"
```

## zero/meta-pico-update/conf/layer.conf
```bitbake
# We have a conf and classes directory, add to BBPATH
BBPATH .= ":${LAYERDIR}"

# We have recipes-* directories, add to BBFILES
BBFILES += "${LAYERDIR}/recipes-mcumgr/mcumgr/mcumgr_0.bb \
            ${LAYERDIR}/recipes-pico-reset/pico-reset/pico-reset_0.bb \
            "

BBFILE_COLLECTIONS += "pico-update"
BBFILE_PATTERN_pico-update = "^${LAYERDIR}/"
BBFILE_PRIORITY_pico-update = "6"

LAYERDEPENDS_pico-update = "raspberrypi"
LAYERSERIES_COMPAT_pico-update = "kirkstone"

ENABLE_UART = "1"
IMAGE_INSTALL:append = " mcumgr pico-reset"
```

## zero/meta-rauc-scsat1/conf/layer.conf
```bitbake
BBPATH .= ":${LAYERDIR}"

BBFILES += "${LAYERDIR}/recipes-*/*/*.bb \
            ${LAYERDIR}/recipes-*/*/*.bbappend"

BBFILE_COLLECTIONS += "meta-rauc-scsat1"
BBFILE_PATTERN_meta-rauc-scsat1 = "^${LAYERDIR}/"
BBFILE_PRIORITY_meta-rauc-scsat1 = "6"

LAYERDEPENDS_meta-rauc-scsat1 = "core"
LAYERSERIES_COMPAT_meta-rauc-scsat1 = "kirkstone"

ENABLE_UART = "1"
RPI_USE_U_BOOT = "1"
IMAGE_INSTALL:append = " rauc"
IMAGE_FSTYPES:append = " ext4"
WKS_FILE = "sdimage-dual-raspberrypi.wks.in"
DISTRO_FEATURES:append = " rauc"
```

## zero/meta-scsat1-rpi/conf/bblayers.conf.sample
```bitbake
# POKY_BBLAYERS_CONF_VERSION is increased each time build/conf/bblayers.conf
# changes incompatibly
POKY_BBLAYERS_CONF_VERSION = "2"

BBPATH = "${TOPDIR}"
BBFILES ?= ""

BBLAYERS ?= " \
  ##OEROOT##/../meta-debug \
  ##OEROOT##/meta \
  ##OEROOT##/../meta-raspberrypi \
  ##OEROOT##/../meta-scsat1-rpi \
  ##OEROOT##/../meta-mcp2517fd \
  ##OEROOT##/../meta-libcsp \
  ##OEROOT##/../meta-csp \
  ##OEROOT##/../meta-openembedded/meta-oe \
  ##OEROOT##/../meta-arducam \
  ##OEROOT##/../meta-rauc \
  ##OEROOT##/../meta-rauc-community/meta-rauc-raspberrypi \
  ##OEROOT##/../meta-rauc-scsat1 \
  "
```

## zero/meta-scsat1-rpi/conf/distro/include/scsat1-rpi-variables.inc
```bitbake
# csp address
MAIN_OBC_CAN_ADDRESS = "8"
RPI_ZERO_CAN_ADDRESS = "24"
RPI_ZERO_UART_ADDRESS = "25"
RPI_PICO_UART_ADDRESS = "26"

# debug
DEBUG_WIFI_SSID ??= ""
DEBUG_WIFI_PASS ??= ""
```

## zero/meta-scsat1-rpi/conf/distro/scsat1-rpi.conf
```bitbake
DISTRO_NAME = "SC-Sat1 RPi Distro"
DISTRO_VERSION = "0.1"

DISTRO_FEATURES:append = " systemd"
DISTRO_FEATURES:BACKFILL_CONSIDERED += "sysvinit"
VIRTUAL-RUNTIME:init_manager = "systemd"  
VIRTUAL-RUNTIME:initscripts = ""
INIT_MANAGER = "systemd"
```
